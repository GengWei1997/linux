## Documentation/devicetree/bindings/display/panel/samsung,ea8076.yaml
```yaml
# SPDX-License-Identifier: GPL-2.0-only OR BSD-2-Clause
%YAML 1.2
---
$id: http://devicetree.org/schemas/display/panel/samsung,ea8076.yaml#
$schema: http://devicetree.org/meta-schemas/core.yaml#

title: Samsung EA8076 6.39" 1080x2340 MIPI-DSI AMOLED Panel

maintainers:
  - GengWei1997 <gw19970326@gmail.com>

description:
  The Samsung EA8076 is a 6.39 inch 1080x2340 MIPI-DSI AMOLED panel found
  in devices such as the Xiaomi Redmi K20 Pro.

allOf:
  - $ref: panel-common.yaml#

properties:
  compatible:
    const: samsung,ea8076

  reg:
    maxItems: 1

  vddio-supply:
    description: I/O source voltage rail

  vcie-supply:
    description: 3.0V source voltage rail

  reset-gpios: true
  port: true

required:
  - compatible
  - reg
  - vddio-supply
  - vcie-supply
  - reset-gpios
  - port

additionalProperties: false

examples:
  - |
    #include <dt-bindings/gpio/gpio.h>

    dsi {
        #address-cells = <1>;
        #size-cells = <0>;

        panel@0 {
            compatible = "samsung,ea8076";
            reg = <0>;

            vddio-supply = <&vreg_l14a_1p8>;
            vcie-supply = <&disp_vci>;

            reset-gpios = <&tlmm 6 GPIO_ACTIVE_LOW>;

            port {
                panel_in: endpoint {
                    remote-endpoint = <&mdss_dsi0_out>;
                };
            };
        };
    };

...
```

## Documentation/devicetree/bindings/input/qcom,pm8150b-haptics.yaml
```yaml
# SPDX-License-Identifier: (GPL-2.0-only OR BSD-2-Clause)
%YAML 1.2
---
$id: http://devicetree.org/schemas/input/qcom,pm8150b-haptics.yaml#
$schema: http://devicetree.org/meta-schemas/core.yaml#

title: Qualcomm PM8150B haptics block

maintainers:
  - GengWei1997 <gw19970326@gmail.com>

description: |
  The PM8150B PMIC contains an H-bridge with a DAC that drives a vibration
  actuator on its HAP_OUT_P/HAP_OUT_M pins.  The DAC plays a level clocked by
  the internal play-rate generator, so the drive amplitude sets the vibration
  strength.

  Only direct play of a constant level is described here, which is what an
  ERM actuator uses.

properties:
  compatible:
    const: qcom,pm8150b-haptics

  reg:
    maxItems: 1

  qcom,vmax-microvolt:
    description: Maximum drive voltage across the actuator.
    minimum: 116000
    maximum: 3596000

  qcom,play-rate-us:
    description: Period of one output sample in microseconds.
    default: 5715
    minimum: 5
    maximum: 20475

required:
  - compatible
  - reg
  - qcom,vmax-microvolt

additionalProperties: false

examples:
  - |
    #include <dt-bindings/spmi/spmi.h>

    pmic@3 {
        compatible = "qcom,pm8150b", "qcom,spmi-pmic";
        reg = <0x3 SPMI_USID>;
        #address-cells = <1>;
        #size-cells = <0>;

        haptics@c000 {
            compatible = "qcom,pm8150b-haptics";
            reg = <0xc000>;

            qcom,vmax-microvolt = <3000000>;
        };
    };
```

## Documentation/devicetree/bindings/input/touchscreen/goodix,gt9886.yaml
```yaml
# SPDX-License-Identifier: (GPL-2.0-only OR BSD-2-Clause)
%YAML 1.2
---
$id: http://devicetree.org/schemas/input/touchscreen/goodix,gt9886.yaml#
$schema: http://devicetree.org/meta-schemas/core.yaml#

title: Goodix GTx8 series I2C touchscreen controller

maintainers:
  - GengWei1997 <gw19970326@gmail.com>

description: |
  The GTx8 family (GT9886 and related parts) speaks a different register
  protocol from the GT9xx controllers handled by goodix.yaml.  Coordinates
  are read from 0x824e and the configuration block is uploaded to 0x8050,
  where the GT9xx parts use 0x814e and 0x8047.

allOf:
  - $ref: touchscreen.yaml#

properties:
  compatible:
    enum:
      - goodix,gt9886
      - goodix,gt9889

  reg:
    enum: [ 0x14, 0x5d ]

  interrupts:
    maxItems: 1

  reset-gpios:
    maxItems: 1
    description: GPIO connected to the controller's reset line.

  irq-gpios:
    maxItems: 1
    description: |
      GPIO connected to the controller's interrupt line.  The line is also
      sampled during reset to select the I2C address, so the driver keeps a
      descriptor for it rather than using the interrupt parent directly.

  vdd-gpios:
    maxItems: 1
    description: GPIO that enables the digital supply rail, if switched.

  avdd-gpios:
    maxItems: 1
    description: GPIO that enables the analog supply rail, if switched.

  goodix,avdd-name:
    description: |
      Name of the regulator that supplies the analog rail, as passed to
      devm_regulator_get().  The driver enables it around the power-on
      sequence.

  goodix,irq-flags:
    $ref: /schemas/types.yaml#/definitions/uint32
    enum: [ 1, 2, 4, 5 ]
    description: |
      Interrupt trigger type: 1 = rising edge, 2 = falling edge,
      4 = high level, 5 = low level.

  goodix,panel-max-x:
    $ref: /schemas/types.yaml#/definitions/uint32
    description: Highest X coordinate the panel reports.

  goodix,panel-max-y:
    $ref: /schemas/types.yaml#/definitions/uint32
    description: Highest Y coordinate the panel reports.

  goodix,panel-max-w:
    $ref: /schemas/types.yaml#/definitions/uint32
    description: Largest contact width the panel reports.

  goodix,panel-max-p:
    $ref: /schemas/types.yaml#/definitions/uint32
    description: Largest pressure value the panel reports.

  goodix,power-on-delay-us:
    $ref: /schemas/types.yaml#/definitions/uint32
    description: Delay after enabling the rails, in microseconds.

  goodix,power-off-delay-us:
    $ref: /schemas/types.yaml#/definitions/uint32
    description: Delay after disabling the rails, in microseconds.

  goodix,cfg-name:
    $ref: /schemas/types.yaml#/definitions/string
    description: |
      Firmware file holding the panel configuration block.  Optional; the
      controller keeps its factory configuration when this is not found.

  goodix,fw-name:
    $ref: /schemas/types.yaml#/definitions/string
    description: Firmware image used by the optional update path.

  goodix,swap-axis:
    $ref: /schemas/types.yaml#/definitions/flag
    description: Swap the X and Y axes.

  goodix,x2x:
    $ref: /schemas/types.yaml#/definitions/flag
    description: Invert the X axis.

  goodix,y2y:
    $ref: /schemas/types.yaml#/definitions/flag
    description: Invert the Y axis.

  goodix,pen-enable:
    $ref: /schemas/types.yaml#/definitions/flag
    description: Enable the stylus/pen input device.

required:
  - compatible
  - reg
  - interrupts
  - reset-gpios
  - irq-gpios
  - goodix,irq-flags

additionalProperties: false

examples:
  - |
    #include <dt-bindings/gpio/gpio.h>
    #include <dt-bindings/interrupt-controller/irq.h>

    i2c {
        #address-cells = <1>;
        #size-cells = <0>;

        touchscreen@5d {
            compatible = "goodix,gt9886";
            reg = <0x5d>;

            interrupt-parent = <&tlmm>;
            interrupts = <122 IRQ_TYPE_EDGE_FALLING>;
            goodix,irq-flags = <2>;

            reset-gpios = <&tlmm 54 GPIO_ACTIVE_HIGH>;
            irq-gpios = <&tlmm 122 GPIO_ACTIVE_HIGH>;
            vdd-gpios = <&tlmm 98 GPIO_ACTIVE_HIGH>;
            avdd-gpios = <&tlmm 100 GPIO_ACTIVE_HIGH>;

            goodix,avdd-name = "ts_avdd_3p3";
            goodix,panel-max-x = <1079>;
            goodix,panel-max-y = <2339>;
            goodix,panel-max-w = <255>;
            goodix,panel-max-p = <255>;
            goodix,power-on-delay-us = <300000>;
            goodix,power-off-delay-us = <5000>;
        };
    };

...
```

## Documentation/devicetree/bindings/power/supply/qcom,pm8150b-charger.yaml
```yaml
# SPDX-License-Identifier: (GPL-2.0-only OR BSD-2-Clause)
%YAML 1.2
---
$id: http://devicetree.org/schemas/power/supply/qcom,pm8150b-charger.yaml#
$schema: http://devicetree.org/meta-schemas/core.yaml#

title: Qualcomm PM8150B SMB5 battery charger and GEN4 fuel gauge

maintainers:
  - GengWei1997 <gw19970326@gmail.com>

description:
  The PM8150B PMIC combines an SMB5 switch-mode battery charger with a GEN4
  fuel gauge.  Both are reached through the PMIC register map, the charger at
  0x1000-0x16ff and the gauge at 0x4000-0x43ff, so a single device covers
  both and exposes the battery and USB power supplies.

  The charge limits come from the battery referenced by monitored-battery:
  the standard maxima bound the charge, and the cell profile's JEITA and
  step-charging tables may lower them further as the battery's temperature
  and voltage move.  The tables are optional and live on the battery node,
  as triplets of low bound, high bound and the value to use between the
  bounds, in the profile's own units:

    - qcom,jeita-fcc-ranges: battery temperature bounds in decidegrees
      Celsius, value is the charge current in microamps;
    - qcom,jeita-fv-ranges: likewise, value is the float voltage in
      microvolts;
    - qcom,step-chg-ranges: battery voltage bounds in microvolts, value is
      the charge current in microamps.

properties:
  compatible:
    const: qcom,pm8150b-charger

  reg:
    maxItems: 1
    description: Base of the SMB5 charger registers.

  interrupts:
    maxItems: 2
    description: Optional charger interrupts; without them the state is polled.

  interrupt-names:
    items:
      - const: usbin-plugin
      - const: chg-state-change

  monitored-battery: true

required:
  - compatible
  - reg
  - monitored-battery

additionalProperties: false

allOf:
  - $ref: power-supply.yaml#

examples:
  - |
    #include <dt-bindings/interrupt-controller/irq.h>

    pmic {
      #address-cells = <1>;
      #size-cells = <0>;

      charger@1000 {
        compatible = "qcom,pm8150b-charger";
        reg = <0x1000>;

        interrupts = <0x2 0x12 0x4 IRQ_TYPE_EDGE_RISING>,
                     <0x2 0x12 0x0 IRQ_TYPE_EDGE_RISING>;
        interrupt-names = "chg-state-change", "usbin-plugin";

        monitored-battery = <&battery>;
      };
    };

    battery {
      compatible = "simple-battery";
      voltage-min-design-microvolt = <3400000>;
      voltage-max-design-microvolt = <4400000>;
      constant-charge-voltage-max-microvolt = <4400000>;
      constant-charge-current-max-microamp = <3200000>;

      qcom,jeita-fcc-ranges = <0   50  390000
                              51  100 1100000
                              101 150 2700000
                              151 450 5100000
                              451 580 1900000>;
      qcom,jeita-fv-ranges = <0   50  4400000
                             51  100 4400000
                             101 150 4400000
                             151 450 4400000
                             451 580 4100000>;
      qcom,step-chg-ranges = <3000000 3100000 1000000
                             3101000 3200000 1000000
                             3201000 3300000 1000000
                             3301000 4200000 5100000
                             4201000 4400000 4000000>;
    };
...
```

## Documentation/devicetree/bindings/power/supply/qcom,smb1390.yaml
```yaml
# SPDX-License-Identifier: (GPL-2.0-only OR BSD-2-Clause)
%YAML 1.2
---
$id: http://devicetree.org/schemas/power/supply/qcom,smb1390.yaml#
$schema: http://devicetree.org/meta-schemas/core.yaml#

title: Qualcomm SMB1390 switched-capacitor charge pump

maintainers:
  - GengWei1997 <gw19970326@gmail.com>

description: |
  The SMB1390 is a 2:1 switched-capacitor charge pump sitting between the
  adapter and the charger's system rail: fed 9 V it feeds the rail at about
  4.5 V, halving the current the buck charger has to convert.  It is
  reached over I2C and exposes its switcher as a current-limited regulator
  for the charger driver to arm; the regulator's current limit is the
  pump's input current limit.  One interrupt wire reports the pump's
  protection trips to the PMIC charger.

properties:
  compatible:
    const: qcom,smb1390

  reg:
    maxItems: 1

  interrupts:
    maxItems: 1
    description: The pump's fault output, wired to a PMIC GPIO.

  regulator-min-microamp:
    description: Lowest input current limit the pump can be set to.

  regulator-max-microamp:
    description: Highest input current limit the pump can be set to.

required:
  - compatible
  - reg
  - interrupts
  - regulator-min-microamp
  - regulator-max-microamp

additionalProperties: false

examples:
  - |
    #include <dt-bindings/interrupt-controller/irq.h>

    i2c {
      #address-cells = <1>;
      #size-cells = <0>;

      charge-pump@10 {
        compatible = "qcom,smb1390";
        reg = <0x10>;

        interrupt-parent = <&pm8150b_gpios>;
        interrupts = <6 IRQ_TYPE_LEVEL_LOW>;

        regulator-min-microamp = <500000>;
        regulator-max-microamp = <3600000>;
      };
    };
...
```

## Documentation/devicetree/bindings/sound/nxp,tfa9874.yaml
```yaml
# SPDX-License-Identifier: (GPL-2.0-only OR BSD-2-Clause)
%YAML 1.2
---
$id: http://devicetree.org/schemas/sound/nxp,tfa9874.yaml#
$schema: http://devicetree.org/meta-schemas/core.yaml#

title: NXP/Goodix TFA9874 (TFA2) Audio Amplifier

maintainers:
  - GengWei1997 <gw19970326@gmail.com>

allOf:
  - $ref: dai-common.yaml#

properties:
  compatible:
    const: nxp,tfa9874

  reg:
    maxItems: 1

  '#sound-dai-cells':
    const: 0

  reset-gpios:
    description:
      GPIO connected to the RST pin. The pin is active high, so the device is
      held in reset while it is asserted.

  sound-name-prefix: true

required:
  - compatible
  - reg
  - '#sound-dai-cells'

additionalProperties: false

examples:
  - |
    #include <dt-bindings/gpio/gpio.h>
    i2c {
      #address-cells = <1>;
      #size-cells = <0>;

      audio-codec@34 {
        compatible = "nxp,tfa9874";
        reg = <0x34>;
        reset-gpios = <&tlmm 59 GPIO_ACTIVE_HIGH>;
        #sound-dai-cells = <0>;
      };
    };
```

## Documentation/devicetree/bindings/ufs/qcom,ufs-common.yaml
```yaml
# SPDX-License-Identifier: GPL-2.0-only OR BSD-2-Clause
%YAML 1.2
---
$id: http://devicetree.org/schemas/ufs/qcom,ufs-common.yaml#
$schema: http://devicetree.org/meta-schemas/core.yaml#

title: Qualcomm Universal Flash Storage (UFS) Controller Common Properties

maintainers:
  - Bjorn Andersson <bjorn.andersson@linaro.org>

properties:
  clocks:
    minItems: 7
    maxItems: 9

  clock-names:
    minItems: 7
    maxItems: 9

  dma-coherent: true

  interconnects:
    minItems: 2
    maxItems: 2

  interconnect-names:
    items:
      - const: ufs-ddr
      - const: cpu-ufs

  iommus:
    minItems: 1
    maxItems: 2

  phys:
    maxItems: 1

  phy-names:
    items:
      - const: ufsphy

  power-domains:
    maxItems: 1

  required-opps:
    maxItems: 1

  resets:
    maxItems: 1

  '#reset-cells':
    const: 1

  reset-names:
    items:
      - const: rst

  reset-gpios:
    maxItems: 1
    description:
      GPIO connected to the RESET pin of the UFS memory device.

  qcom,no-runtime-pm:
    type: boolean
    description: |
      Keep the link, the host clocks and the PHY powered at all times.

      The QMP UFS PHY is calibrated from the HCE-enable path only.  On
      platforms where a runtime power transition powers the PHY down, the
      next hibern8 exit or transfer aborts with a PA fatal error and the
      link never recovers, because the calibration is not part of the
      runtime resume path.  Such boards can disable clock gating, clock
      scaling, runtime autosuspend and the auto-hibernate timer here, so
      the link is never torn down at runtime.  System suspend is not
      affected: it runs a full HCE disable/enable cycle which
      re-initialises the PHY.

allOf:
  - $ref: ufs-common.yaml

additionalProperties: true
```
